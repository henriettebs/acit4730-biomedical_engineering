#include "Nicla_OLED.h" // Header file
#include "Nicla_System.h" // Built-in commands
#include <stdint.h>
#include <Adafruit_GFX.h> // Graphics core library for drawing animations and progress bar
#include <Adafruit_SSD1306.h> // Library needed for OLED SSD1306
#include <Wire.h> // Library for using I2C (Inter-Integrated Circuit) for connecting to OLED SDA and SCL ports

// --- SCREEN SETUP ---
#define SCREEN_WIDTH 128
#define SCREEN_HEIGHT 64
#define OLED_RESET -1
Adafruit_SSD1306 oled(SCREEN_WIDTH, SCREEN_HEIGHT, &Wire, OLED_RESET);

// --- ANIMATION SETUP ---
#define FRAMEDELAY 42
#define FRAMEWIDTH 48
#define FRAMEHEIGHT 48
#define FRAMECOUNT (sizeof(starAnimation) / sizeof(starAnimation[0]))
const byte PROGMEM starAnimation[][288] = {
  {0,0,0,0,0,0,0,0,1,0,0,0,0,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0,0},
  {0,0,0,0,0,0,0,0,1,0,0,0,0,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0,0},
  {0,0,0,0,0,0,0,0,1,0,0,0,0,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0,0},
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  {0,0,0,0,0,0,0,0,1,0,0,0,0,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0,0}
};
const byte PROGMEM faceAnimation[][288] = {
  {0,0,0,0,0,0,0,0,0,0,0,0,0,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0,0},
  {0,0,0,0,0,0,0,0,0,0,0,0,0,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0,0},
  {0,0,0,0,0,0,0,0,0,0,0,0,0,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0,0},
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  {0,0,0,0,0,0,0,0,0,0,0,0,0,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0,0}
};

// --- SCREEN ITERATION SETUP ---
const unsigned long SCREEN_INTERVAL = 3000; // Screen switches every 3 seconds
unsigned long lastSwitch = 0; // Variable used to store time passed since the screen last switched
int currentScreen = 0; // Variable used to store which screen is currently displayed

void initOLED() {
  nicla::leds.begin();
  if(!oled.begin(SSD1306_SWITCHCAPVCC, 0x3C)) {
    return; // If screen fails to initalize
  }
  
  // Test screen
  //oled.clearDisplay();
  oled.setTextColor(SSD1306_WHITE);
  //oled.display();
}

// --- ANIMATION SCREEN ---
void drawScreen0(int currentStreak, int longestStreak) { 
  static unsigned long lastFrameTime = 0;
  static int screenFrame = 0;

  oled.clearDisplay();
  oled.setTextSize(1);
  oled.setTextColor(1);
  oled.setCursor(0, 0);
  oled.print("Streak");
  oled.setCursor(35, 14);
  oled.setTextSize(5);
  oled.print(currentStreak);

  if (lastFrameTime == 0) {
    lastFrameTime = millis();
  }

  unsigned long now = millis();
  unsigned long timePassed = now - lastFrameTime;
  int framesToAdvance = timePassed / FRAMEDELAY;

  if (millis() - lastFrameTime >= 50) {
    screenFrame = (screenFrame + 1) % FRAMECOUNT;
    lastFrameTime += framesToAdvance * FRAMEDELAY;
  }
  if (currentStreak > 0) {
    oled.drawBitmap(70, 8, starAnimation[screenFrame], FRAMEWIDTH, FRAMEHEIGHT, 1);
  } else {
    oled.drawBitmap(70, 8, faceAnimation[screenFrame], FRAMEWIDTH, FRAMEHEIGHT, 1);
  }
  oled.setCursor(0, 55);
  oled.setTextSize(1);
  oled.print("Longest streak: ");
  oled.println(longestStreak);
  oled.display();
}

// --- STEPS AND BATTERY ---
void drawScreen1(uint32_t steps, int batteryLevel) {
  oled.clearDisplay();
  oled.setTextSize(1);
  oled.setTextColor(1);
  oled.setCursor(0, 0);
  oled.println("Steps: ");
  oled.setTextSize(2);
  oled.println(steps);
  oled.setTextSize(1);
  oled.println("Battery: ");
  oled.setTextSize(2);
  oled.print(batteryLevel);
  oled.println("%");
}

// --- WORN/REMOVED ---
void drawScreen2(bool isWorn) {
  oled.clearDisplay();
  oled.setTextSize(2);
  oled.setTextColor(1);
  oled.setCursor(0, 0);
  oled.println("Status: ");
  oled.println(isWorn ? "WORN" : "REMOVED");
}

// --- DAILY GOAL PROGRESS BAR ---
void drawScreen3(String time, uint32_t wornSeconds, int goalHours) {
  int goalSeconds = (goalHours * 3600);
  int percent = (wornSeconds * 100) / goalSeconds;

  if (wornSeconds >= goalSeconds) {
    goalSeconds = wornSeconds;
  }

  oled.clearDisplay();
  oled.setTextSize(1);
  oled.setTextColor(1);
  oled.setCursor(0, 0);
  oled.print("Worn: "); oled.println(time);
  oled.print("Goal: "); oled.print(goalHours); oled.println("h");
  oled.print("Percent: "); oled.print(percent); oled.println("%");

  int barX = 0;
  int barY = 32;
  int barW = 125;
  int barH = 10;

  oled.drawRect(barX, barY, barW, barH, 1);

  int fillW = (wornSeconds * (barW - 2)) / goalSeconds;
  oled.fillRect(barX + 1, barY + 1, fillW, barH - 2, 1);

  if(goalSeconds == wornSeconds) {
    oled.setCursor(20, 45);
    oled.println("Goal achieved!");
    oled.setCursor(28, 55);
    oled.println("Keep going!");
  }
}

// --- ROTATION OF SCREENS ---
void updateDisplay(uint32_t steps, bool isWorn, String time, uint32_t wornSeconds, int goalHours, int currentStreak, int longestStreak, int batteryLevel) {
  if (millis() - lastSwitch >= SCREEN_INTERVAL) {
    currentScreen = (currentScreen + 1) % 4;
    lastSwitch = millis();
  }

  switch (currentScreen) {
    case 0: drawScreen0(currentStreak, longestStreak); break;
    case 1: drawScreen1(steps, batteryLevel); break;
    case 2: drawScreen2(isWorn); break;
    case 3: drawScreen3(time, wornSeconds, goalHours); break;
  }
  oled.display();
}

// REMOVE THIS ONE!!!
void displayTroubleShoot(bool temp, bool motion, bool galvanic, int skinRaw) {
  oled.clearDisplay();
  oled.setTextSize(1);
  oled.setTextColor(SSD1306_WHITE);
  oled.setCursor(0,0);
  oled.print("Temp: ");
  oled.println(temp);
  oled.print("Motion: ");
  oled.println(motion);
  oled.print("Skin contact: ");
  oled.println(galvanic);
  oled.println("Skin value");
  oled.println(skinRaw);
  oled.display();
}

// --- REMINDER TO PATIENT ---
void displayWarningScreen() {
  oled.clearDisplay();
  oled.setTextSize(2);
  oled.setTextColor(SSD1306_WHITE);
  oled.setCursor(15, 5);
  oled.println("REMEMBER");
  oled.setCursor(50, 25);
  oled.println("TO");
  oled.setCursor(35, 45);
  oled.println("WEAR!");
  oled.display();
}

void clearDisplay() {
  oled.clearDisplay();
  oled.display();
}